## configs/project1_x86_64_defconfig
```kconfig
BR2_x86_64=y
BR2_DL_DIR="../dl"
BR2_CCACHE=y
BR2_PACKAGE_OVERRIDE_FILE="$(BR2_EXTERNAL_PROJECT1_PATH)/local.mk"
BR2_GLOBAL_PATCH_DIR="$(TOPDIR)/../patches"
BR2_TOOLCHAIN_BUILDROOT_GLIBC=y
BR2_KERNEL_HEADERS_4_17=y
BR2_GCC_ENABLE_LTO=y
BR2_ROOTFS_MERGED_USR=y
BR2_TARGET_GENERIC_HOSTNAME="project1"
BR2_TARGET_GENERIC_ISSUE="Welcome to Project 1"
BR2_TARGET_GENERIC_PASSWD_SHA256=y
# BR2_TARGET_ENABLE_ROOT_LOGIN is not set
BR2_TARGET_GENERIC_GETTY_TERM="linux"
# BR2_TARGET_GENERIC_REMOUNT_ROOTFS_RW is not set
BR2_SYSTEM_ENABLE_NLS=y
BR2_TARGET_TZ_INFO=y
BR2_ROOTFS_OVERLAY="$(BR2_EXTERNAL_PROJECT1_PATH)/fs-overlay ../board/x86_64/fs-overlay"
BR2_ROOTFS_POST_BUILD_SCRIPT="$(BR2_EXTERNAL_PROJECT1_PATH)/post-build-hook ../board/x86_64/post-build-hook"
BR2_ROOTFS_POST_IMAGE_SCRIPT="$(BR2_EXTERNAL_PROJECT1_PATH)/post-image-hook ../board/x86_64/post-image-hook"
BR2_LINUX_KERNEL=y
BR2_LINUX_KERNEL_USE_CUSTOM_CONFIG=y
BR2_LINUX_KERNEL_CUSTOM_CONFIG_FILE="../board/x86_64/linux-4.17.config"
BR2_TARGET_ROOTFS_EXT2=y
BR2_TARGET_ROOTFS_EXT2_4=y
BR2_TARGET_ROOTFS_EXT2_LABEL="rootfs"
BR2_TARGET_ROOTFS_SQUASHFS=y
# BR2_TARGET_ROOTFS_TAR is not set
```
